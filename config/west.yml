## config/west.yml
```yaml
manifest:
  remotes:
    - name: zmkfirmware
      url-base: https://github.com
    - name: duckyb
      url-base: https://github.com
  projects:
    - name: zmk
      remote: zmkfirmware
      revision: main
      import: app/west.yml
    - name: urchin-zmk-module
      remote: duckyb
      revision: main
  self:
    path: config
```
